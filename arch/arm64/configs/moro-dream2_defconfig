## arch/arm64/configs/moro-dream2_defconfig
```kconfig
# CONFIG_RKP_6G is not set
CONFIG_CAMERA_CIS_3M3_OBJ=y
# CONFIG_CAMERA_DREAM is not set
CONFIG_CAMERA_DREAM2=y
CONFIG_SUPPORT_POC_FLASH=y
CONFIG_SENSORS_HRM_ADPD143=y
```

## arch/arm64/configs/moro-dream_defconfig
```kconfig
# CONFIG_RKP_6G is not set
# CONFIG_CAMERA_CIS_3M3_OBJ is not set
CONFIG_CAMERA_DREAM=y
# CONFIG_CAMERA_DREAM2 is not set
# CONFIG_SUPPORT_POC_FLASH is not set
# CONFIG_SENSORS_HRM_ADPD143 is not set
```
